## meta-st-openeuler/conf/layer.conf
```bitbake
# We have a conf and classes directory, add to BBPATH
BBPATH .= ":${LAYERDIR}"

# We have a recipes-* directories, add to BBFILES
BBFILES += "${LAYERDIR}/recipes-*/*/*.bb \
            ${LAYERDIR}/recipes-*/*/*.bbappend \
"

# This folder should only contains specific patches to fix issue on oe recipes
# Note that these patches may be pushed on Community
BBFILES += "${LAYERDIR}/oe-core/recipes-*/*/*.bbappend"

BBFILE_COLLECTIONS += "st-openeuler"
BBFILE_PATTERN_st-openeuler := "^${LAYERDIR}/"
BBFILE_PRIORITY_st-openeuler = "5"

# dependency with meta-networking for netperf, ntp
LAYERDEPENDS_st-openeuler += " networking-layer "
# dependency with meta-webserver for netdata
LAYERDEPENDS_st-openeuler += " webserver "

# dependency with meta-multimedia for gstreamer dependency (faac)
LAYERDEPENDS_st-openeuler += " multimedia-layer"


# This should only be incremented on significant changes that will
# cause compatibility issues with other layers
LAYERVERSION_st-openeuler = "1"
LAYERSERIES_COMPAT_st-openeuler = "kirkstone"
```

## meta-st-stm32mp/conf/machine/myd-ld25x-oee.conf
```bitbake
#@TYPE: Machine
#@NAME: stm32mp2
#@DESCRIPTION: Configuration for myd-ld25x openEuler Embedded version
#@NEEDED_BSPLAYERS: layers/meta-openembedded/meta-oe layers/meta-openembedded/meta-python

# Define specific familly common machine name
MACHINEOVERRIDES =. "stm32mp2common:stm32mp25common:"

include conf/machine/include/st-machine-common-stm32mp.inc
include conf/machine/include/st-machine-providers-stm32mp.inc

# =========================================================================
# Kernel, use openEuler Embedded's kernel framework
# =========================================================================
PREFERRED_PROVIDER_virtual/kernel = "linux-openeuler"

MACHINENAME="myd-ld25x-oee"

#kernel modules to install and autoload
require conf/machine/include/kernel-modules-conf/common.inc

# ext2 support is part of kernel, need to set CONFIG_EXT2_FS=m
INSTALLMODULES:remove = "kernel-module-ext2"
# need to set CONFIG_NFS_FS=m CONFIG_NFS_V3=m
INSTALLMODULES:remove = "kernel-module-nfs kernel-module-nfsv3"
# need to set CONFIG_SUNRPC=m CONFIG_SUNRPC_GSS=m
INSTALLMODULES:remove = "kernel-module-sunrpc kernel-module-auth-rpcgss"
# need to set CONFIG_LOCKD=m
INSTALLMODULES:remove = "kernel-module-lockd"
# need to  set CONFIG_GRACE_PERIOD=m
INSTALLMODULES:remove = "kernel-module-grace"
# need to set  CONFIG_PACKET=m
INSTALLMODULES:remove = "kernel-module-af-packet"
# need to set CONFIG_CRC_CCITT=m
INSTALLMODULES:remove = "kernel-module-crc-ccitt"


KERNEL_MODULE_AUTOLOAD = "${INSTALLMODULES}"


# =========================================================================
# Chip architecture
# =========================================================================
DEFAULTTUNE = "cortexa35"
include conf/machine/include/arm/armv8a/tune-cortexa35.inc

PREFERRED_PROVIDER_u-boot-fw-utils:stm32mp2common = "libubootenv"

MACHINE_EXTRA_RRECOMMENDS:append:stm32mp2common = " \
    u-boot-fw-config-stm32mp \
"
# =========================================================================
# boot scheme
# =========================================================================
BOOTSCHEME_LABELS = "optee"
BOOTSCHEME_LABELS += "fastboot"
#uboot config
#BOOT_SELECT = "1"
#UBOOT_CONFIG:append:stm32mp25common = " ${@bb.utils.contains('BOOTSELECT', '1', 'default_2G', '', d)} "
#UBOOT_CONFIG:append:stm32mp25common = " ${@bb.utils.contains('BOOTSELECT', '0', 'default_1G', '', d)} "
# =========================================================================
# OPTEE profile
# =========================================================================
# Optee profile, permit to activate or desactvate a list of service on optee.
# There is two configuration available:
#  - secure_and_system_services aka optee boot scheme
#  - system_services aka opteemin boot scheme

# Default optee profile use by all soc, (if exception see if there is a specific
# profile for a soc)
ST_OPTEE_PROFILE ?= "secure_and_system_services"
#ST_OPTEE_EXPORT_TA_REF_BOARD:stm32mp2common = "stm32mp257f-dk.dts"
#2G DDR
ST_OPTEE_EXPORT_TA_REF_BOARD:stm32mp2common = "myb-stm32mp257x-2GB.dts"
# =========================================================================
# boot device
# =========================================================================
# Define the boot device supported
BOOTDEVICE_LABELS += "emmc"
BOOTDEVICE_LABELS += "nor-sdcard"
BOOTDEVICE_LABELS += "sdcard"

IMAGE_ROOTFS_MAXSIZE = "4000000"
# =========================================================================
# Machine settings
# =========================================================================
# Define list of devicetree per supported storage
#kernel dtb
KERNEL_SUB_PATH = "myir/"
STM32MP_DT_FILES_EMMC   += "myb-stm32mp257x-2GB"
STM32MP_DT_FILES_SDCARD += "myb-stm32mp257x-2GB"


# =========================================================================
# Machine features
# =========================================================================
MACHINE_FEATURES += "splashscreen"
MACHINE_FEATURES += "watchdog"
MACHINE_FEATURES += "bluetooth"
MACHINE_FEATURES += "wifi"

# GPU
MACHINE_FEATURES += "${@'gpu' if d.getVar('ACCEPT_EULA_'+d.getVar('MACHINE')) == '1' else ''}"
MACHINE_FEATURES += "${@'openvx' if d.getVar('ACCEPT_EULA_'+d.getVar('MACHINE')) == '1' else ''}"
MACHINE_FEATURES += "${@'opencl' if d.getVar('ACCEPT_EULA_'+d.getVar('MACHINE')) == '1' else ''}"
MACHINE_FEATURES += "${@'vulkan' if d.getVar('ACCEPT_EULA_'+d.getVar('MACHINE')) == '1' else ''}"

# M33
MACHINE_FEATURES += "m33copro"

# Bluetooth
BLUETOOTH_LIST += "linux-firmware-bluetooth-bcm4343"
# Wifi
WIFI_LIST += "linux-firmware-bcm43439"
# PCIe
PCI_LIST += "linux-firmware-rtl8168"

# activate external dt
EXTERNAL_DT_ENABLED = "1"

# ==========================================================================
# M33 Boards
# ==========================================================================
# Lists of boards/devicetree on which the m33 service MUST be started
M33_BOARDS_START_AT_STARTUP = "stm32mp257f-dk stm32mp257f-ev1"
M33_BOARDS_START_AT_STARTUP =+ "${@bb.utils.contains('EXTERNAL_DT_ENABLED', '1', 'stm32mp257f-dk-ca35tdcid-ostl', '', d)}"
M33_BOARDS_START_AT_STARTUP =+ "${@bb.utils.contains('EXTERNAL_DT_ENABLED', '1', 'stm32mp257f-ev1-ca35tdcid-ostl', '', d)}"

DISK_DRIVE = "/dev/mmcblk1"
# Set time zone
DEFAULT_TIMEZONE = "Asia/Shanghai"

UBOOT_EXTLINUX_DEFAULT_LABEL = "openEuler Embedded"
UBOOT_EXTLINUX_MENU_DESCRIPTION:rootfs = "openEuler Embedded"
```
